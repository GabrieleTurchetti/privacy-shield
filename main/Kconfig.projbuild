## main/Kconfig.projbuild
```kconfig
menu "Privacy Shield Configuration"

    # =================================================================
    #  Device Role
    # =================================================================
    choice PRIVACY_SHIELD_ROLE
        prompt "Device Role"
        default PRIVACY_SHIELD_ROLE_NODE
        help
            Node:  Full audio pipeline (mic + DSP + speaker) + ESP-NOW mesh.
                   The masking device you attach to doors/windows.

            Hub:   ESP-NOW mesh listener + WiFi softAP + Web dashboard.
                   No audio hardware needed. Control all nodes from a browser.

        config PRIVACY_SHIELD_ROLE_NODE
            bool "Masking Node"
        config PRIVACY_SHIELD_ROLE_HUB
            bool "Hub Controller"
    endchoice

    # =================================================================
    #  Hub WiFi (station mode)
    # =================================================================
    #  The Hub joins your existing home WiFi as a station so the
    #  dashboard is reachable on your LAN (http://privacyshield.local)
    #  without your phone losing internet. Only used in Hub role.
    config PRIVACY_SHIELD_WIFI_SSID
        string "Home WiFi SSID (Hub only)"
        default "iPhone di Donaldo"
        help
            SSID of the network the Hub connects to. Ignored by Nodes.

    config PRIVACY_SHIELD_WIFI_PASSWORD
        string "Home WiFi password (Hub only)"
        default "privacyshield123"
        help
            Password for the above network. Leave empty for an open network
            (and change the auth threshold in wifi_sta_connect()).

    # =================================================================
    #  Build Mode
    # =================================================================
    choice PRIVACY_SHIELD_BUILD_MODE
        prompt "Build mode"
        default PRIVACY_SHIELD_BUILD_DEBUG
        help
            Debug mode:
              - Raw audio samples printed over serial (2M baud)
              - All log levels enabled
              - Per-subsystem toggles available below

            Production mode:
              - No raw audio output
              - All component logs silenced (WARN only)
              - Main tag stays at INFO (banner + neighbor count)

        config PRIVACY_SHIELD_BUILD_DEBUG
            bool "Debug (raw audio + verbose logs)"
        config PRIVACY_SHIELD_BUILD_PRODUCTION
            bool "Production (DSP pipeline + quiet logs)"
    endchoice

    # Derived: used by i2s_mic.c to toggle raw audio dump
    config PRIVACY_SHIELD_DEBUG_MODE
        bool
        default y if PRIVACY_SHIELD_BUILD_DEBUG
        default n if PRIVACY_SHIELD_BUILD_PRODUCTION

    # =================================================================
    #  Per-Subsystem Log Toggles (Debug mode only)
    # =================================================================
    menu "Subsystem Log Levels"
        visible if PRIVACY_SHIELD_BUILD_DEBUG

        config PRIVACY_SHIELD_LOG_MESH
            bool "Mesh log level: Debug"
            default y
            help
                When ON: mesh_core + discovery log at DEBUG.
                Shows HELLO broadcasts, neighbor table changes, send status.

                When OFF: mesh_core at INFO, discovery at WARN.

        config PRIVACY_SHIELD_LOG_AUDIO
            bool "Audio log level: Debug"
            default y
            help
                When ON: AUDIO_HAL_MIC logs at DEBUG.
                Shows calibration details, buffer reads, sample counts.

                When OFF: AUDIO_HAL_MIC at WARN.
        config PRIVACY_SHIELD_LOG_AUDIO_AFE
            bool "Audio AFE log level: Debug"
            default y
            help
                When ON: LOG_TAG_AUDIO_AFE logs at DEBUG.
                Shows calibration details, buffer reads, sample counts.

                When OFF: LOG_TAG_AUDIO_AFE at WARN.
        config PRIVACY_SHIELD_LOG_WEB
            bool "Web log level: Debug"
            default y
            help
                When ON: LOG_TAG_WEB logs at DEBUG.
                Shows calibration details, buffer reads, sample counts.

                When OFF: LOG_TAG_WEB at WARN.
        config PRIVACY_SHIELD_LOG_BATTERY
            bool "Battery log level: Debug"
            default y
            help
                When ON: LOG_TAG_BATTERY logs at DEBUG.
                Shows calibration details, buffer reads, sample counts.

                When OFF: LOG_TAG_BATTERY at WARN.

    endmenu

endmenu
```
